// dactyl_cc_left.overlay

#include "dactyl_cc.dtsi" // Notice that the main dtsi files are included in the overlay.

&kscan0 {
    col-gpios
        = <&gpio0 10 GPIO_ACTIVE_HIGH>
        , <&gpio0 16 GPIO_ACTIVE_HIGH>
        , <&gpio1 14  GPIO_ACTIVE_HIGH>
        , <&gpio0 15 GPIO_ACTIVE_HIGH>
        , <&gpio1 18 GPIO_ACTIVE_HIGH>
        , <&gpio1 19 GPIO_ACTIVE_HIGH>
        , <&gpio1 20 GPIO_ACTIVE_HIGH>
        ;
};
